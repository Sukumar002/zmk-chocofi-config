#include "layout_shift.dtsi"

/ {
    behaviors {
        /* Explicit native keypress alias retained for diagnostics and Studio. */
        original_key_press: original_key_press {
            compatible = "zmk,behavior-key-press";
            #binding-cells = <1>;
        };
    };
};
