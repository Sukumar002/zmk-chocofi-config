#include "chocofi_central_dongle.overlay"

/*
 * The Pro Micro 128x32 SSD1306 hardware node and chosen display are supplied
 * by oled_adapter_pro_micro_128x32, matching the adapter-based build setup.
 */
