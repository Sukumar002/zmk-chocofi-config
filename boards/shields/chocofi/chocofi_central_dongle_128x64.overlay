#include "chocofi_central_dongle.overlay"

/*
 * Reuse the SSD1306 node inherited from chocofi.dtsi.
 * Both declarations use the same I2C path (ssd1306@3c), so declaring a
 * second node with a different label does not create a second device:
 * it aliases/overlays the existing node. Reconfigure that node directly.
 */
&oled {
    status = "okay";
    width = <128>;
    height = <64>;
    segment-offset = <0>;
    page-offset = <0>;
    display-offset = <0>;
    multiplex-ratio = <63>;
    segment-remap;
    com-invdir;
    com-sequential;
    inversion-on;
    prechargep = <0x22>;
};

/ {
    chosen {
        zephyr,display = &oled;
    };
};
