## boards/shields/chocofi/Kconfig.defconfig
```kconfig
# SPDX-License-Identifier: MIT

if SHIELD_CHOCOFI_CENTRAL_DONGLE || SHIELD_CHOCOFI_CENTRAL_DONGLE_128X64 || SHIELD_CHOCOFI_CENTRAL_DONGLE_128X32 || SHIELD_CHOCOFI_CENTRAL_LEFT
config ZMK_SPLIT_ROLE_CENTRAL
    default y
endif

if SHIELD_CHOCOFI_CENTRAL_DONGLE || SHIELD_CHOCOFI_CENTRAL_DONGLE_128X64 || SHIELD_CHOCOFI_CENTRAL_DONGLE_128X32
config ZMK_KEYBOARD_NAME
    default "Chocofi Dongle"
endif

if SHIELD_CHOCOFI_CENTRAL_LEFT
config ZMK_KEYBOARD_NAME
    default "Chocofi"
endif

if SHIELD_CHOCOFI_PERIPHERAL_LEFT
config ZMK_KEYBOARD_NAME
    default "Chocofi Left"
config ZMK_SPLIT_ROLE_CENTRAL
    default n
endif

if SHIELD_CHOCOFI_PERIPHERAL_RIGHT
config ZMK_KEYBOARD_NAME
    default "Chocofi Right"
config ZMK_SPLIT_ROLE_CENTRAL
    default n
endif

if SHIELD_CHOCOFI_LEFT || SHIELD_CHOCOFI_RIGHT || SHIELD_CHOCOFI_CENTRAL_DONGLE || SHIELD_CHOCOFI_CENTRAL_DONGLE_128X64 || SHIELD_CHOCOFI_CENTRAL_DONGLE_128X32 || SHIELD_CHOCOFI_CENTRAL_LEFT || SHIELD_CHOCOFI_PERIPHERAL_LEFT || SHIELD_CHOCOFI_PERIPHERAL_RIGHT
config ZMK_SPLIT
    default y

config SPI
    default y

config I2C
    default y

if ZMK_DISPLAY
config SSD1306
    default y

choice LV_FONT_DEFAULT
    default LV_FONT_DEFAULT_MONTSERRAT_12
endchoice

choice ZMK_LV_FONT_DEFAULT_SMALL
    default ZMK_LV_FONT_DEFAULT_SMALL_MONTSERRAT_12
endchoice

config LV_Z_VDB_SIZE
    default 64

config LV_DPI_DEF
    default 148

config LV_Z_BITS_PER_PIXEL
    default 1

choice LV_COLOR_DEPTH
    default LV_COLOR_DEPTH_1
endchoice
endif # ZMK_DISPLAY
endif
```

## boards/shields/chocofi/Kconfig.shield
```kconfig
# SPDX-License-Identifier: MIT

config SHIELD_CHOCOFI_LEFT
    def_bool $(shields_list_contains,chocofi_left)

config SHIELD_CHOCOFI_RIGHT
    def_bool $(shields_list_contains,chocofi_right)

config SHIELD_CHOCOFI_CENTRAL_DONGLE
    def_bool $(shields_list_contains,chocofi_central_dongle)

config SHIELD_CHOCOFI_PERIPHERAL_LEFT
    def_bool $(shields_list_contains,chocofi_peripheral_left)

config SHIELD_CHOCOFI_PERIPHERAL_RIGHT
    def_bool $(shields_list_contains,chocofi_peripheral_right)
```

## dts/bindings/behaviors/zmk,behavior-base-view-toggle.yaml
```yaml
description: Cycle the persistent BASE display view

compatible: "zmk,behavior-base-view-toggle"

include: zero_param.yaml
```

## dts/bindings/behaviors/zmk,behavior-oled-brightness.yaml
```yaml
description: Adjust SSD1306 OLED contrast (perceived brightness)

compatible: "zmk,behavior-oled-brightness"

include: one_param.yaml
```

## dts/bindings/behaviors/zmk,behavior-timeout-cycle.yaml
```yaml
description: Cycle display and split-half inactivity timeouts

compatible: "zmk,behavior-timeout-cycle"

include: one_param.yaml
```
